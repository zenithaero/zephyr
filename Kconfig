## Kconfig
```kconfig
# General configuration options

# Copyright (c) 2014-2015 Wind River Systems, Inc.
# SPDX-License-Identifier: Apache-2.0

mainmenu "Zephyr Kernel Configuration"

source "${MERCURY_PATH}/firmware/conf/Kconfig.mercury"
```

## Kconfig.mercury
```kconfig
# Mercury configuration options

source "Kconfig.zephyr"

menu "Mercury options"

# System

choice 
  prompt "MERCURY BOARD TYPE"

config MERCURY_MAIN_CONTROL
  bool "MERCURY_MAIN_CONTROL"
  
config MERCURY_CONSOLE
  bool "MERCURY_CONSOLE"

endchoice

# Threads
config MERCURY_THREAD_CONTROLLER
  bool "MERCURY_THREAD_CONTROLLER"
  default y

config MERCURY_THREAD_FILELOG
  bool "MERCURY_THREAD_FILELOG"
  depends on FILE_SYSTEM
  default y


config MERCURY_THREAD_DISPLAY
  bool "MERCURY_THREAD_DISPLAY"
  depends on DISPLAY
  default y

config MERCURY_THREAD_SERVICE
  bool "MERCURY_THREAD_SERVICE"
  default y

config MERCURY_THREAD_COMMUNICATION
  bool "MERCURY_THREAD_COMMUNICATION"
  default y

config MERCURY_THREAD_SITL
  bool "MERCURY_THREAD_SITL"
  depends on NATIVE_POSIX
  default n

# UART Expander
config MERCURY_DEVICE_UART_EXPANDER
  bool "MERCURY_DEVICE_UART_EXPANDER"
  depends on !NATIVE_POSIX && (SPI || I2C) && MERCURY_THREAD_SERVICE
  default y

# Device modules
config MERCURY_DEVICE_SERVO
  bool "MERCURY_DEVICE_SERVO"
  depends on MERCURY_THREAD_SERVICE
  default y

config MERCURY_DEVICE_AHRS
  bool "MERCURY_DEVICE_AHRS"
  depends on MERCURY_THREAD_SERVICE
  default y

config MERCURY_DEVICE_GYRO
  bool "MERCURY_DEVICE_GYRO"
  depends on MERCURY_THREAD_SERVICE
  default y

config MERCURY_DEVICE_RSSI
  bool "MERCURY_DEVICE_RSSI"
  depends on MERCURY_THREAD_SERVICE
  default y

config MERCURY_DEVICE_FAN
  bool "MERCURY_MODULE_FAN"
  depends on !NATIVE_POSIX && MERCURY_THREAD_SERVICE
  default y

# Communication modules
config MERCURY_COMM_MAV_TELEMETRY
  bool "MERCURY_COMM_MAV_TELEMETRY"
  depends on MERCURY_THREAD_COMMUNICATION
  default y

config MERCURY_COMM_MAV_DISPLAY
  bool "MERCURY_COMM_MAV_DISPLAY"
  depends on MERCURY_THREAD_COMMUNICATION
  default y

config MERCURY_COMM_MONITOR
  bool "MERCURY_COMM_MONITOR"
  depends on MERCURY_THREAD_COMMUNICATION
  default y


# Sitl
config MERCURY_FORCE_SITL_SERVO
  bool
  imply MERCURY_SITL_SERVO
  default MERCURY_DEVICE_SERVO && !CANOPEN

config MERCURY_SITL_SERVO
  bool "MERCURY_SITL_SERVO"
  depends on MERCURY_DEVICE_SERVO

config MERCURY_SITL_GYRO
  bool "MERCURY_SITL_GYRO"
  depends on MERCURY_DEVICE_GYRO

config MERCURY_SITL_AHRS
  bool "MERCURY_SITL_AHRS"
  depends on MERCURY_DEVICE_AHRS

config MERCURY_SITL_RSSI
  bool "MERCURY_SITL_RSSI"
  depends on MERCURY_DEVICE_RSSI

# Lib
config MERCURY_LIB_CANOPEN
  bool
  default CANOPEN && MERCURY_DEVICE_SERVO && !MERCURY_SITL_SERVO

config MERCURY_LIB_SBG
  bool
  default (MERCURY_DEVICE_AHRS && !MERCURY_SITL_AHRS) || (MERCURY_DEVICE_GYRO && !MERCURY_SITL_GYRO)
endmenu
```

## west.yml
```yaml
# The west manifest file for upstream Zephyr.
#
# The per-installation west configuration file, .west/config, sets the
# path to the project containing this file in the [manifest] section's
# "path" variable.
#
# You are free to create your own manifest files and put them in any
# repository you want, to create your own custom Zephyr installations.
# For example, you could create a manifest file in your own out of
# tree application directory, which would pull this zephyr repository
# in as an ordinary project.
#
# You can pass your manifest repositories to west init when creating a
# new Zephyr installation. See the west documentation for more
# information.

manifest:
  defaults:
    remote: upstream

  remotes:
    - name: upstream
      url-base: https://github.com/zephyrproject-rtos
    - name: babblesim
      url-base: https://github.com/BabbleSim

  group-filter: [-babblesim, -optional]

  #
  # Please add items below based on alphabetical order
  projects:
    - name: cmsis
      revision: 4b96cbb174678dcd3ca86e11e1f24bc5f8726da0
      path: modules/hal/cmsis
      groups:
        - hal
    - name: cmsis-dsp
      revision: 6489e771e9c405f1763b52d64a3f17a1ec488ace
      path: modules/lib/cmsis-dsp
    - name: cmsis-nn
      revision: ea987c1ca661be723de83bd159aed815d6cbd430
      path: modules/lib/cmsis-nn
    - name: fatfs
      revision: 427159bf95ea49b7680facffaa29ad506b42709b
      path: modules/fs/fatfs
      groups:
        - fs
    - name: hal_st
      revision: b77157f6bc4395e398d90ab02a7d2cbc01ab2ce7
      path: modules/hal/st
      groups:
        - hal
    - name: hal_stm32
      revision: f1317150eac951fdd8259337a47cbbc4c2e6d335
      path: modules/hal/stm32
      groups:
        - hal
    - name: littlefs
      path: modules/fs/littlefs
      groups:
        - fs
      revision: 408c16a909dd6cf128874a76f21c793798c9e423

  self:
    path: zephyr
    west-commands: scripts/west-commands.yml
    import: submanifests
```
